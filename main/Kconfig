## main/Kconfig
```kconfig
menu "WWVB Emulator Configuration"

    config WWVB_WIFI_POP
        string "WiFi Provisioning Proof-of-Possession"
        default "abcd1234"
        help
            Proof-of-Possession (PoP) string for BLE WiFi provisioning.
            Used during device provisioning to ensure authorized provisioners.
            Must be > 0 characters for Security 1 provisioning.
            
            WARNING: This default should NOT be used in production releases.
            Change to a secure, randomly-generated PoP before release builds.

    config WWVB_NTP_SERVER
        string "NTP server hostname"
        default "pool.ntp.org"
        help
            Hostname used by SNTP to synchronize UTC system time.

    config WWVB_OUTPUT_GPIO
        int "WWVB carrier output GPIO"
        range 0 48
        default 26
        help
            GPIO used for the 60 kHz WWVB carrier output (LEDC PWM).

    config WWVB_STATUS_LED_GPIO
        int "Status LED GPIO"
        range 0 48
        default 13
        help
            GPIO used as the status/debug LED output.

    config WWVB_STATUS_LED_BLINK_HZ
        int "Status LED blink rate while waiting for SNTP sync (Hz)"
        range 1 50
        default 8
        help
            Blink rate for the status LED while waiting for SNTP synchronization.
            This is the full on/off cycle rate in Hertz.

    config WWVB_STATUS_HEARTBEAT_ENABLE
        bool "Enable status LED heartbeat during runtime"
        default y
        help
            When enabled, the status LED toggles during normal runtime in
            TimerSecond_ISR as a heartbeat indication.

    config WWVB_STATUS_HEARTBEAT_HZ
        int "Heartbeat LED blink rate during runtime (Hz)"
        depends on WWVB_STATUS_HEARTBEAT_ENABLE
        range 1 50
        default 1
        help
            Blink rate for the status LED during normal runtime operation.
            This is the full on/off cycle rate in Hertz, using the same
            convention as WWVB_STATUS_LED_BLINK_HZ.

    config WWVB_CARRIER_FREQ_HZ
        int "WWVB carrier frequency (Hz)"
        range 1000 1000000
        default 60000
        help
            LEDC carrier frequency in Hz. WWVB nominal carrier is 60000 Hz.

    config WWVB_WIFI_RETRY_LIMIT
        int "WiFi reconnect retry limit"
        range 0 100
        default 10
        help
            Number of reconnect attempts after a WiFi disconnect before
            setting WIFI_FAIL_BIT.

endmenu
```

## main/Kconfig.projbuild
```kconfig
menu "WWVB Configuration"

    config WWVB_OUTPUT_PIN
        int "WWVB Output GPIO Pin"
        range 0 39
        default 26
        help
            GPIO pin number for WWVB 60kHz signal output.
            Default is 26 (A0 on the Huzzah32 Featherboard).
            Valid range: 0-39 (ESP32 GPIO range).
            Note: GPIOs 6-11 are typically used for SPI flash and should be avoided.

    config WWVB_DEBUG_LED_PIN
        int "Debug LED GPIO Pin"
        range 0 39
        default 13
        help
            GPIO pin number for debug LED output.
            Default is 13.
            Valid range: 0-39 (ESP32 GPIO range).
            Note: GPIOs 6-11 are typically used for SPI flash and should be avoided.

    config WWVB_NTP_SERVER
        string "NTP Server"
        default "pool.ntp.org"
        help
            NTP server hostname or IP address for time synchronization.
            Default is "pool.ntp.org".

    config WIFI_MAX_RETRY
        int "WiFi Connection Max Retry"
        range 1 100
        default 10
        help
            Maximum number of WiFi connection retry attempts.
            Default is 10.
            Valid range: 1-100.

endmenu
```

## test/main/Kconfig
```kconfig
menu "WWVB Emulator Configuration"

    config WWVB_WIFI_POP
        string "WiFi Provisioning Proof-of-Possession"
        default "abcd1234"
        help
            Proof-of-Possession (PoP) string for BLE WiFi provisioning.
            Used during device provisioning to ensure authorized provisioners.
            Must be > 0 characters for Security 1 provisioning.
            
            For testing: default value is used since provisioning is tested separately.

endmenu
```
